## conf/layer.conf
```bitbake
# We have a conf and classes directory, add to BBPATH
BBPATH .= ":${LAYERDIR}"

# We have a packages directory, add to BBFILES
BBFILES += "${LAYERDIR}/recipes-*/*/*.bb \
            ${LAYERDIR}/recipes-*/*/*.bbappend"

BBFILE_COLLECTIONS += "austin"
BBFILE_PATTERN_austin := "^${LAYERDIR}/"
BBFILE_PRIORITY_austin = "5"

#DISTRO_EXTRA_RDEPENDS += "dropbear lrzsz"
```

## conf/machine/imx23evk.conf
```bitbake
#@TYPE: Machine
#@NAME: i.MX233 austin board 
#@DESCRIPTION: Machine configuration for OHSUNG austin mx233 product

include conf/machine/include/mxs-base.inc

IMXBOOTLETS_MACHINE = "stmp378x_dev"

KERNEL_IMAGETYPE = "zImage"
KERNEL_DEVICETREE = "${S}/arch/arm/boot/dts/imx23-evk.dts"

IMAGE_BOOTLOADER = "imx-bootlets"

IMAGE_FSTYPES ?= "ubi tar.bz2 jffs2 linux.sb"
MKUBIFS_ARGS = "-m 2048 -e 126976 -c 2030"
#UBINIZE_ARGS = "-m 2048 -p 128KiB -s 2048 -O 2048"
UBINIZE_ARGS = "-m 2048 -p 128KiB -s 512 -O 2048"

MACHINE_FEATURES = "usbgadget serial"
```
